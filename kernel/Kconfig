## kernel/Kconfig
```kconfig
menu "Egysk"

config EGYSK
	tristate "Egysk init RC and policy helper"
	depends on KPROBES && SECURITY_SELINUX
	default y
	help
	  Enable the root-only init RC supplement and SELinux policy helper.
	  Requires CONFIG_KPROBES for distinct control FD installation.
	  To compile as a module, choose M here: the artifact is
	  egysk.ko, with internal name egysk.
	  A loadable module must be loaded by PID 1 during early boot.
	  Direct syscall hooks keep a loadable module resident once published:
	  another hook may retain its callback in a saved-original chain.
	  The helper observes only PID 1's second-stage init policy readiness.
	  It does not grant credentials, track apps or own boot-mode reports.
	  Bootstrap and module RC are supplied once by root (maximum 64 KiB).

config EGYSK_DEBUG
	bool "Egysk debug mode"
	depends on EGYSK
	default n
	help
	  Enable Egysk debug mode.

config EGYSK_X86_PATCH_SYSCALL_DISPATCHER
	bool "Dynamically patch x64's hardened syscall dispatcher to support syscall hooks"
	depends on EGYSK && X86_64
	default n
	help
	  Dynamically patch x64's hardened syscall dispatcher to support syscall hooks. This is a
	  replacement for a kernel source code patch, and is useful for x86_64 LKM mode.

endmenu
```
